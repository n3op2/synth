#define A 8
#define B 9
#define C 10
#define D 11
#define E 12

int     wave1[] = {0,0,0,0,0,0,0,0,0,0,0,0,0,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255,255};
int wave2[] = {128,131,134,137,140,143,146,149,152,155,158,162,165,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121,124};
int wave3[] = {171,232,31,74,194,83,49,230,217,101,52,74,216,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6,251};


int currentStep = 0;
int c = 0;
bool playing = false;
bool recording = false;
int steps[] = { 0, 0, 0, 0, 0, 0, 0, 0, 0, 0, 0, 0, 0, 0, 0, 0 };
bool setting = false;

unsigned short int led_matrix[16][10] = {
  // PIN / STATE
  { 1, 1, 1, 0, 0, 0, 0, 0, 0, 0 }, // 1
  { 1, 0, 1, 1, 0, 0, 0, 0, 0, 0 }, // 2
  { 1, 1, 0, 0, 1, 0, 0, 0, 0, 0 }, // 3
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  { 0, 0, 0, 0, 1, 0, 1, 1, 0, 0 }, // 16
};

void showLed(int id) {
  pinMode(A, led_matrix[id][0]);
  pinMode(B, led_matrix[id][2]);
  pinMode(C, led_matrix[id][4]);
  pinMode(D, led_matrix[id][6]);
  pinMode(E, led_matrix[id][8]);
  digitalWrite(A, led_matrix[id][1]);
  digitalWrite(B, led_matrix[id][3]);
  digitalWrite(C, led_matrix[id][5]);
  digitalWrite(D, led_matrix[id][7]);
  digitalWrite(E, led_matrix[id][9]);
}

void setup() {
  Serial.begin(9600);

  cli();//stop interrupts

  pinMode(13, OUTPUT);
  pinMode(14, OUTPUT);
  pinMode(15, OUTPUT);
  pinMode(20, OUTPUT);
  pinMode(16, OUTPUT);
  pinMode(17, OUTPUT);
  pinMode(18, INPUT);
  pinMode(19, INPUT);


  DDRD = 0xFF;//port d (digital pins 0-7) all outputs

  TCCR2A = 0;// set entire TCCR2A register to 0
  TCCR2B = 0;// same for TCCR2B
  TCNT2  = 0;//initialize counter value to 0
  // --- mmmm?
  // trigger = 4us 16Mhz / prescaler
  // note = note_hz / 256 / trigger
  OCR2A = 16;
  TCCR2A |= B00000010;
  TCCR2B |= B00000010;
  TIMSK2 |= B00000010;

  sei();
}

ISR(TIMER2_COMPA_vect) {
  TCNT2 = 0;
  if (playing || recording) PORTD = wave2[c];
  if (c == 255) c = 0;
  else c++;
}

void loop() {
  if (digitalRead(18) > 0 && !setting) playing = !playing;

  if (digitalRead(19) > 0) {
    if (!playing) {
      recording = true;
    }
    delay(30);
    playing = false;
    digitalWrite(16, LOW);
  }

  record();
  play();
}

void record() {
  if (!recording) return;
  digitalWrite(16, LOW);
  digitalWrite(17, HIGH);
  setting = true;
  short int current = 0;

  while(current + 1 <= sizeof(steps) / sizeof(steps[0])) {
    showLed(current);
    int hz = analogRead(1) / 3;
    Serial.print(hz);
    if (digitalRead(19) > 0 && current != 0) {
      steps[current] = 666;
      current++;
      digitalWrite(16, HIGH);
    } else if (digitalRead(18) > 0) {
      steps[current] = hz;
      current++;
      digitalWrite(16, HIGH);
    }
    OCR2A = hz;
    delay(300);
    digitalWrite(16, LOW);
  }

  setting = false;
  recording = false;

}

void play() {
    if (!playing) return;
    digitalWrite(16, HIGH);
    digitalWrite(17, LOW);
    if (currentStep >= (sizeof(steps) / sizeof(steps[0]))) {
      currentStep = 0;
    }

    TCNT2 = 0;
    int step = steps[currentStep];
    Serial.print("\n step: ");
    Serial.print(step);
    Serial.print("\n currentStep: ");
    Serial.print(currentStep);
    if (step == 666) TCCR2B = 0;
    OCR2A = step;
    delay(110);
    TCCR2B = 0;
    delay(10);
    TCCR2B |= B00000010;
    currentStep++;
    showLed(currentStep);
}


